## Documentation/devicetree/bindings/arm/xen,dev-domid.yaml
```yaml
# SPDX-License-Identifier: (GPL-2.0-only or BSD-2-Clause)
%YAML 1.2
---
$id: http://devicetree.org/schemas/arm/xen,dev-domid.yaml#
$schema: http://devicetree.org/meta-schemas/core.yaml#

title: Xen specific binding for virtualized devices (e.g. virtio)

maintainers:
  - Stefano Stabellini <sstabellini@kernel.org>

select: true

description:
  This binding indicates that Xen grant mappings need to be enabled for
  the device, and it specifies the ID of the domain where the corresponding
  device (backend) resides. The property is required to restrict memory
  access using Xen grant mappings.

properties:
  xen,dev-domid:
    $ref: /schemas/types.yaml#/definitions/uint32
    description:
      The domid (domain ID) of the domain where the device (backend) is running.

additionalProperties: true

examples:
  - |
    virtio@3000 {
            compatible = "virtio,mmio";
            reg = <0x3000 0x100>;
            interrupts = <41>;

            /* The device is located in Xen domain with ID 1 */
            xen,dev-domid = <1>;
    };
```

## Documentation/devicetree/bindings/iommu/xen,grant-dma.yaml
```yaml
# SPDX-License-Identifier: (GPL-2.0-only or BSD-2-Clause)
%YAML 1.2
---
$id: http://devicetree.org/schemas/iommu/xen,grant-dma.yaml#
$schema: http://devicetree.org/meta-schemas/core.yaml#

title: Xen specific IOMMU for virtualized devices (e.g. virtio)

maintainers:
  - Stefano Stabellini <sstabellini@kernel.org>

description:
  The reference to Xen specific IOMMU node using "iommus" property indicates
  that Xen grant mappings need to be enabled for the device, and it specifies
  the ID of the domain where the corresponding backend resides.
  The binding is required to restrict memory access using Xen grant mappings.

properties:
  compatible:
    const: xen,grant-dma

  '#iommu-cells':
    const: 1
    description:
      Xen specific IOMMU is multiple-master IOMMU device.
      The single cell describes the domid (domain ID) of the domain where
      the backend is running.

required:
  - compatible
  - "#iommu-cells"

additionalProperties: false

examples:
  - |
    xen_iommu {
        compatible = "xen,grant-dma";
        #iommu-cells = <1>;
    };

    virtio@3000 {
        compatible = "virtio,mmio";
        reg = <0x3000 0x100>;
        interrupts = <41>;

        /* The backend is located in Xen domain with ID 1 */
        iommus = <&xen_iommu 1>;
    };
```

## Documentation/devicetree/bindings/media/renesas,jpu.txt
```
* Renesas JPEG Processing Unit

The JPEG processing unit (JPU) incorporates the JPEG codec with an encoding
and decoding function conforming to the JPEG baseline process, so that the JPU
can encode image data and decode JPEG data quickly.

Required properties:
  - compatible: should containg one of the following:
			- "renesas,jpu-gen2" for R-Car H2
			- "renesas,jpu-gen2" for R-Car M2-W
			- "renesas,jpu-gen2" for R-Car V2H
			- "renesas,jpu-gen2" for R-Car M2-N

  - reg: Base address and length of the registers block for the JPU.
  - interrupts: JPU interrupt specifier.
  - clocks: A phandle + clock-specifier pair for the JPU functional clock.

Example: R8A7790 (R-Car H2) JPU node
	jpeg-codec@fe980000 {
		compatible = "renesas,jpu-gen2";
		reg = <0 0xfe980000 0 0x10300>;
		interrupts = <0 272 IRQ_TYPE_LEVEL_HIGH>;
		clocks = <&mstp1_clks R8A7790_CLK_JPU>;
	};
```

## Documentation/devicetree/bindings/virtio/mmio.txt
```
* virtio memory mapped device

See https://ozlabs.org/~rusty/virtio-spec/ for more details.

Required properties:

- compatible:	"virtio,mmio" compatibility string
- reg:		control registers base address and size including configuration space
- interrupts:	interrupt generated by the device

Optional properties:

- xen,dev_domid:	Specifies the ID of Xen domain where the corresponding
		device (backend) resides. This is needed for the option to restrict
		memory access using Xen grant mappings to work. Note that current
		and generic iommus options are mutually exclusive, since the restricted
		memory access model on Xen behaves as a kind of software IOMMU.

Example:

	virtio_block@3000 {
		compatible = "virtio,mmio";
		reg = <0x3000 0x100>;
		interrupts = <41>;

		/* The device is located in Xen domain with ID 1 */
		xen,dev_domid = <1>;
	}

Required properties for virtio-iommu:

- #iommu-cells:	When the node corresponds to a virtio-iommu device, it is
		linked to DMA masters using the "iommus" or "iommu-map"
		properties [1][2]. #iommu-cells specifies the size of the
		"iommus" property. For virtio-iommu #iommu-cells must be
		1, each cell describing a single endpoint ID.

Optional properties:

- iommus:	If the device accesses memory through an IOMMU, it should
		have an "iommus" property [1]. Since virtio-iommu itself
		does not access memory through an IOMMU, the "virtio,mmio"
		node cannot have both an "#iommu-cells" and an "iommus"
		property.

Example:

	virtio_block@3000 {
		compatible = "virtio,mmio";
		reg = <0x3000 0x100>;
		interrupts = <41>;

		/* Device has endpoint ID 23 */
		iommus = <&viommu 23>
	}

	viommu: iommu@3100 {
		compatible = "virtio,mmio";
		reg = <0x3100 0x100>;
		interrupts = <42>;

		#iommu-cells = <1>
	}

[1] Documentation/devicetree/bindings/iommu/iommu.txt
[2] Documentation/devicetree/bindings/pci/pci-iommu.txt
```

## Documentation/devicetree/bindings/virtio/xen,dev-domid.yaml
```yaml
# SPDX-License-Identifier: (GPL-2.0-only or BSD-2-Clause)
%YAML 1.2
---
$id: http://devicetree.org/schemas/virtio/xen,dev-domid.yaml#
$schema: http://devicetree.org/meta-schemas/core.yaml#

title: Xen specific binding for the virtio device

maintainers:
  - Oleksandr Tyshchenko <oleksandr_tyshchenko@epam.com>

select: true

description:
  This binding specifies the ID of Xen domain where the corresponding device
  (backend) resides. This is needed for the option to restrict memory access
  using Xen grant mappings to work.

  Note that current and generic "iommus" bindings are mutually exclusive, since
  the restricted memory access model on Xen behaves as a kind of software IOMMU.

properties:
  xen,dev-domid:
    $ref: /schemas/types.yaml#/definitions/uint32
    description:
      Should contain the ID of device's domain.

additionalProperties: true

examples:
  - |
    virtio_block@3000 {
            compatible = "virtio,mmio";
            reg = <0x3000 0x100>;
            interrupts = <41>;

            /* The device is located in Xen domain with ID 1 */
            xen,dev-domid = <1>;
    };
```
